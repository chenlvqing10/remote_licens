## remote_licens/linux-3.10/arch/arm/mach-lombo/Kconfig
```kconfig
if ARCH_LOMBO

menu "LomboTech Board Support"

config ARCH_LOMBO_N7
	bool "E81 CPU architecture"
	select CPU_V7
	select MULTI_IRQ_HANDLER
	select GENERIC_IRQ_CHIP
	select SPARSE_IRQ
	select ARM_GIC
	select HAVE_SMP

if ARCH_LOMBO_N7

config ARCH_LOMBO_N7V0
	bool "The First Soc with E81 CPU"
	select HAVE_CLK
	select COMMON_CLK
	select CLKSRC_MMIO
	select GENERIC_CLOCKEVENTS
	select ARCH_REQUIRE_GPIOLIB
	select PINCTRL
	select PINCTRL_N7
	select OF

if ARCH_LOMBO_N7V0
choice
	prompt "Board select for ARCH_LOMBO_N7V0 Soc"
	default ARCH_LOMBO_N7V0_EVB

config ARCH_LOMBO_N7V0_EVB
	bool "EVB board for ARCH_LOMBO_N7V0 Soc"
	help
	  This is the evb board for
	  ARCH_LOMBO_N7V0 Soc,
	  which used as the development
	  board when the
	  IC is ok.

config ARCH_LOMBO_N7V0_FPGA
	bool "FPGA board for ARCH_LOMBO_N7V0 Soc"
	help
	  This is the fpga board for ARCH_LOMBO_N7V0 Soc

config ARCH_LOMBO_N7V0_DEMO_BOARD
	bool "Demo board for ARCH_LOMBO_N7V0 Soc"
	help
	  This is the demo board for ARCH_LOMBO_N7V0 Soc
endchoice
endif	# ARCH_LOMBO_N7V0

config ARCH_LOMBO_N7V1
	bool "The Second Soc with E81 CPU"
	select HAVE_CLK
	select COMMON_CLK
	select CLKSRC_MMIO
	select GENERIC_CLOCKEVENTS
	select ARCH_REQUIRE_GPIOLIB
	select PINCTRL
	select PINCTRL_N7
	select OF

if ARCH_LOMBO_N7V1
choice
	prompt "Board select for ARCH_LOMBO_N7V1 Soc"
	default ARCH_LOMBO_N7V1_EVB

config ARCH_LOMBO_N7V1_EVB
	bool "EVB board for ARCH_LOMBO_N7V1 Soc"
	help
	  This is the evb board for
	  ARCH_LOMBO_N7V1 Soc,
	  which used as the development
	  board when the
	  IC is ok.

config ARCH_LOMBO_N7V1_EVB_SIP
	bool "EVB_SIP board for ARCH_LOMBO_N7V1 Soc"
	help
	  This is the evb_sip board for
	  ARCH_LOMBO_N7V1 Soc,
	  which used as the development
	  board when the
	  IC is ok.

config ARCH_LOMBO_N7V1_FPGA
	bool "FPGA board for ARCH_LOMBO_N7V1 Soc"
	help
	  This is the fpga board for ARCH_LOMBO_N7V1 Soc
endchoice
endif	# ARCH_LOMBO_N7V1

endif	# ARCH_LOMBO_N7

endmenu	# LomboTech SoCs Support

#
# configurations for power management
#
comment "Power management"

config LOMBO_PM_DEBUG
        bool "LOMBO PM Suspend debug"
	default n
        depends on PM
        select DEBUG_LL
        help
	  This is for debug during suspend and resume.
	  Say Y here if you want to debug during PM Suspend and Resume flow,
	  where the console maybe closed.
	  If uart was closed before, we should realize pm_debug_init to re-init
	  uart port.

config LOMBO_PM_CHECK
        bool "LOMBO PM Suspend Memory CRC"
        depends on PM && CRC32
        help
          Enable the PM code's memory area checksum over sleep. This option
          will generate CRCs of all blocks of memory, and store them before
          going to sleep. The blocks are then checked on resume for any
          errors. Note: this can take several seconds depending on memory
          size and CPU speed.

endif	# ARCH_LOMBO
```

## remote_licens/linux-3.10/drivers/block/lombo_spnd/Kconfig
```kconfig
config LOMBO_SPND
	tristate "Lombo SPI Nand Device Driver"
	depends on ARCH_LOMBO
	help
	  Device driver for Lombo SPI Nand Device Driver.

	  To compile this driver as a module, choose M here: the
	  module will be called lombo_spnd.
```

## remote_licens/linux-3.10/drivers/dma/lombo/Kconfig
```kconfig
#
# DMA engine configuration for lombotech
#

config LOMBO_DMAC
	tristate "Support lombo dma"
	depends on ARCH_LOMBO
	select DMA_ENGINE
	help
	  This is the common config for lombo dma controller, for use
	  dma engine framework to apply interface for ohter drivers.

	  If you want to use drivers that require dma operations,
	  answer Y or M. Otherwise say N.
```

## remote_licens/linux-3.10/drivers/gpu/drm/lombo/Kconfig
```kconfig
menuconfig DRM_LOMBO
	tristate "Lombo SoC DRM/KMS Driver"
	depends on DRM && ARCH_LOMBO && OF
	select LOMBO_DRM_KMS_HELPER_WRAPPER
	select LOMBO_DRM_KMS_CMA_HELPER_WRAPPER
	help
	  Choose this option if you have an LOMBO SoC with
	  DPU/DOSS. If M is selected the module will be called
	  lombo-drm.
	  haha.

if DRM_LOMBO

config LOMBO_DRM_KMS_HELPER_WRAPPER
	tristate "LOMBO DRM KMS HELPER wrapper"
	default y
	select DRM_KMS_HELPER
	help
	  Choose this option if you neen select DRM_KMS_HELPER.
	  This option can let you config DRM_KMS_HELPER as Y if
	  LOMBO DRM modules are configed as M.
	  hahah

config LOMBO_DRM_KMS_CMA_HELPER_WRAPPER
	bool "LOMBO DRM KMS CMA HELPER wrapper"
	select DRM_KMS_CMA_HELPER
	help
	  Choose this option if you neen select DRM_KMS_CMA_HELPER.
	  This option can let you config DRM_KMS_HELPER as Y if
	  LOMBO DRM modules are configed as M.
	  haha.

config DRM_LOMBO_DPU_TOP
	tristate "Support for LOMBO DPU TOP"
	help
	  Choose this option if you have an LOMBO SoC with DPU.
	  If M is selected the module will be called lombo-dpu.
	  haha
	  haha

config DRM_LOMBO_DC
	tristate "Support for LOMBO DPU DC"
	depends on DRM_LOMBO_DPU_TOP
	help
	  Choose this option if you have an LOMBO Soc with DPU,
	  which has a Display Controller to do some alpha blending
	  and feed graphics to TCON. If M is selected the module
	  will be called lombo-dc.

config DRM_LOMBO_OVE
	tristate "Support for LOMBO DPU OVE"
	depends on DRM_LOMBO_DPU_TOP
	help
	  Choose this option if you have an LOMBO Soc with DPU,
	  which has a OVE to do some non-alpha blending
	  and feed graphics to extenal processor.
	  If M is selected the module will be called lombo-ove.

config DRM_LOMBO_SE
	tristate "Support for LOMBO DPU SE"
	depends on DRM_LOMBO_DPU_TOP
	help
	  Choose this option if you have an LOMBO Soc with DPU,
	  which has a Display Controller to do some alpha blending
	  and feed graphics to dc or writeback to memory.
	  If M is selected the module will be called lombo-se.

config DRM_LOMBO_WB
	tristate "Support for LOMBO DPU WB"
	depends on DRM_LOMBO_DPU_TOP
	help
	  Choose this option if you have an LOMBO Soc with DPU,
	  which has a WB module.
	  IF M is selected the module will be called lombo-wb.
	  haha

config DRM_LOMBO_DIT
	tristate "Support for LOMBO DIT"
	depends on DRM_LOMBO_DPU_TOP
	help
	  Choose this option if you have an LOMBO SoC with DPU,
	  which has a DIT module. IF M is selected the module
	  will be called lombo-dit.
	  haha

config DRM_LOMBO_ROT
	tristate "Support for LOMBO ROT"
	depends on DRM_LOMBO_DPU_TOP
	help
	  Choose this option if you have an LOMBO SoC with DPU,
	  which has a ROT module. IF M is selected the module
	  will be called lombo-dit.
	  haha

config DRM_LOMBO_DOSS_TOP
	tristate "Support for LOMBO DOSS TOP"
        help
	  Choose this option if you have an LOMBO SoC with DOSS.
	  If M is selected the module will be called lombo-doss.
	  haha
	  haha

config DRM_LOMBO_TCON
	tristate "Support for LOMBO DOSS TCON"
	depends on DRM_LOMBO_DOSS_TOP
	select DRM_PANEL
	help
	  Choose this option if you have an LOMBO SoC with DOSS,
	  which has a Timing Controller. If M is selected the
	  module will be called lombo-tcon.
	  haha

config DRM_LOMBO_MIPI_DSI
	tristate "Support for LOMBO DOSS MIPI DSI"
	depends on DRM_LOMBO_DOSS_TOP
	help
	  Choose this option if you have an LOMBO SoC with DOSS,
	  which has a MIPI DSI module. IF M is selected the
	  module will be called lombo-dsi.
	  haha

config DRM_LOMBO_TVE
	tristate "Support for LOMBO DOSS TVE"
	depends on DRM_LOMBO_DOSS_TOP
	help
	  Choose this option if you have an LOMBO SoC with DOSS,
	  which has a TVE module. IF M is selected the
	  module will be called lombo-tve.
	  haha
endif
```
