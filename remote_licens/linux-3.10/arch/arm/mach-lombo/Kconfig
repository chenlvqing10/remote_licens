## remote_licens/linux-3.10/drivers/input/ir/Kconfig
```kconfig
#
# Input core configuration
#
menuconfig INPUT_IR
	bool "irs"
	default y
	help
	  Say Y here, and a list of supported ir will be displayed.
	  This option doesn't affect the kernel.

	  If unsure, say Y.

if INPUT_IR

config IR_LOMBO_N7
	tristate "Lombo ir"
	depends on ARCH_LOMBO_N7V1
	help
	  Say Y to enable infrared radiation module support for the Lombo Tech N7 platforms.

	  To compile this driver as a module, choose M here: the
	  module will be called lombo_ir.

endif
```

## remote_licens/linux-3.10/drivers/media/platform/lombo-viss/Kconfig
```kconfig
menuconfig VIDEO_LOMBO_VISS
	bool "Lombo Video Input Sub-System"
	depends on ARCH_LOMBO && VIDEO_DEV && VIDEO_V4L2 && VIDEO_V4L2_SUBDEV_API
	select VIDEOBUF2_DMA_CONTIG
	default n
	help
	    lombo viss driver
	    To compile this driver as build-in, choose y here
	    To compile this driver as a module, choose M here: the
	    module will be called lombo-viss-vic.

if VIDEO_LOMBO_VISS

config VIDEO_LOMBO_VIC
	tristate "Lombo DVP interface driver"
	default n
	help
	  This is a V4L2 driver for lombo dvp interface

	  To compile this driver as build-in, choose y here
	  To compile this driver as a module, choose M here: the
	  module will be called lombo-viss-vic.

config VIDEO_LOMBO_MIPI_CSI
	tristate "Lombo MIPI-CSI interface driver"
	default n
	help
	  This is a V4L2 driver for lombo mipi-csi interface

	  To compile this driver as built-in, choose y here
	  To compile this driver as a module, choose M here: the
	  module will be called lombo-viss-mipi-csi.

config VIDEO_LOMBO_ISP
	tristate "Lombo ISP driver"
	default n
	help
	  This is a V4L2 driver for lombo ISP

	  To compile this driver as build-in, choose y here
	  To compile this driver as a module, choose M here: the
	  module will be called lombo-viss-is.

source drivers/media/platform/lombo-viss/cccore/Kconfig

endif # VIDEO_LOMBO_VISS
```

## remote_licens/linux-3.10/drivers/media/platform/lombo-viss/cccore/Kconfig
```kconfig
menuconfig VIDEO_LOMBO_CCCORE
	tristate "Lombo Camera Control Core"
	depends on I2C && VIDEO_V4L2
	depends on MEDIA_CAMERA_SUPPORT
	---help---
	  Support for the Lombo Camera Control.

	  To compile this driver as build-in, choose y here
	  To compile this driver as a module, choose M here: the
	  module will be called lombo-cccore.

if VIDEO_LOMBO_CCCORE
	source drivers/media/platform/lombo-viss/cccore/sensors/Kconfig
endif # VIDEO_LOMBO_CCCORE
```

## remote_licens/linux-3.10/drivers/media/platform/lombo-viss/cccore/sensors/Kconfig
```kconfig
config LOMBO_AR0230_DVP
	tristate "AR0230 DVP sensor support"
	depends on I2C && VIDEO_V4L2
	depends on MEDIA_CAMERA_SUPPORT
	---help---
	  This is a Video4Linux2 sensor-level driver for the
	  AR0230 camera.

	  To compile this driver as a module, choose M here: the
	  module will be called ar0230_dvp.

config LOMBO_OV2718_DVP
	tristate "OmniVision OV2718 DVP sensor support"
	depends on I2C && VIDEO_V4L2
	depends on MEDIA_CAMERA_SUPPORT
	---help---
	  This is a Video4Linux2 sensor-level driver for the OmniVision
	  OV271X camera.

	  To compile this driver as a module, choose M here: the
	  module will be called ov2718_dvp.

config LOMBO_OV2710_DVP
	tristate "OmniVision OV2710 DVP sensor support"
	depends on I2C && VIDEO_V4L2
	depends on MEDIA_CAMERA_SUPPORT
	---help---
	  This is a Video4Linux2 sensor-level driver for the OmniVision
	  OV271X camera.

	  To compile this driver as a module, choose M here: the
	  module will be called ov2710_dvp.

config LOMBO_OV5640_DVP
	tristate "OmniVision OV5640 DVP sensor support"
	depends on I2C && VIDEO_V4L2
	depends on MEDIA_CAMERA_SUPPORT
	---help---
	  This is a Video4Linux2 sensor-level driver for the OmniVision
	  OV5640 camera.

	  To compile this driver as a module, choose M here: the
	  module will be called ov5640_dvp.

config LOMBO_GC2145_DVP
	tristate "GC2145 DVP sensor support"
	depends on I2C && VIDEO_V4L2
	depends on MEDIA_CAMERA_SUPPORT
	---help---
	  This is a Video4Linux2 sensor-level driver for the GC2145
	  MIPI camera.

	  To compile this driver as a module, choose M here: the
	  module will be called gc2145_dvp.

config LOMBO_GC2145_MIPI
	tristate "GC2145 MIPI sensor support"
	depends on I2C && VIDEO_V4L2
	depends on MEDIA_CAMERA_SUPPORT
	---help---
	  This is a Video4Linux2 sensor-level driver for the GC2145
	  MIPI camera.

	  To compile this driver as a module, choose M here: the
	  module will be called gc2145_mipi.

config LOMBO_GC2053_MIPI
	tristate "GC2053 MIPI sensor support"
	depends on I2C && VIDEO_V4L2
	depends on MEDIA_CAMERA_SUPPORT
	---help---
	  This is a Video4Linux2 sensor-level driver for the GC2053
	  MIPI camera.

	  To compile this driver as a module, choose M here: the
	  module will be called gc2053_mipi.

config LOMBO_OV2718_MIPI
	tristate "OmniVision OV2718 MIPI sensor support"
	depends on I2C && VIDEO_V4L2
	depends on MEDIA_CAMERA_SUPPORT
	---help---
	  This is a Video4Linux2 sensor-level driver for the OmniVision
	  OV2718 MIPI camera.

	  To compile this driver as a module, choose M here: the
	  module will be called ov2718_mipi.

config LOMBO_IMX307_MIPI
	tristate "Sony IMX307 MIPI sensor support"
	depends on I2C && VIDEO_V4L2
	depends on MEDIA_CAMERA_SUPPORT
	---help---
	  This is a Video4Linux2 sensor-level driver for the Sony
	  IMX307 MIPI camera.

	  To compile this driver as a module, choose M here: the
	  module will be called imx307_mipi.

config LOMBO_IMX327_MIPI
	tristate "Sony IMX327 MIPI sensor support"
	depends on I2C && VIDEO_V4L2
	depends on MEDIA_CAMERA_SUPPORT
	---help---
	  This is a Video4Linux2 sensor-level driver for the Sony
	  IMX307 MIPI camera.

	  To compile this driver as a module, choose M here: the
	  module will be called imx327_mipi.

config LOMBO_OV8858_MIPI
	tristate "OmniVision OV8858 MIPI sensor support"
	depends on I2C && VIDEO_V4L2
	depends on MEDIA_CAMERA_SUPPORT
	---help---
	  This is a Video4Linux2 sensor-level driver for the OmniVision
	  OV8858 MIPI camera.

	  To compile this driver as a module, choose M here: the
	  module will be called ov8858_mipi.

config LOMBO_OV9281_MIPI
	tristate "OV9281 MIPI sensor support"
	depends on I2C && VIDEO_V4L2
	depends on MEDIA_CAMERA_SUPPORT
	---help---
	  This is a Video4Linux2 sensor-level driver for the OV9281
	  MIPI camera.

	  To compile this driver as a module, choose M here: the
	  module will be called ov9281_mipi.

config LOMBO_OV5640_MIPI
	tristate "OmniVision OV5640 MIPI sensor support"
	depends on I2C && VIDEO_V4L2
	depends on MEDIA_CAMERA_SUPPORT
	---help---
	  This is a Video4Linux2 sensor-level driver for the OmniVision
	  OV5640 MIPI camera.

	  To compile this driver as a module, choose M here: the
	  module will be called ov5640_mipi.

config LOMBO_SC2363P_MIPI
	tristate "XC6130-SC2363P MIPI sensor support"
	depends on I2C && VIDEO_V4L2
	depends on MEDIA_CAMERA_SUPPORT
	---help---
	  This is a Video4Linux2 sensor-level driver for the XC6130-SC2363P
	  MIPI camera.

	  To compile this driver as a module, choose M here: the
	  module will be called sc2363p_mipi.

config LOMBO_OV2735_MIPI
	tristate "OmniVision OV2735 MIPI sensor support"
	depends on I2C && VIDEO_V4L2
	depends on MEDIA_CAMERA_SUPPORT
	---help---
	  This is a Video4Linux2 sensor-level driver for the OmniVision
	  OV2735 MIPI camera.

	  To compile this driver as a module, choose M here: the
	  module will be called ov2735_mipi.

config LOMBO_OS02K10_MIPI
	tristate "OmniVision OS02K10 MIPI sensor support"
	depends on I2C && VIDEO_V4L2
	depends on MEDIA_CAMERA_SUPPORT
	---help---
	  This is a Video4Linux2 sensor-level driver for the OmniVision
	  OS02K10 MIPI camera.

	  To compile this driver as a module, choose M here: the
	  module will be called os02k10_mipi.

config LOMBO_OV4689_MIPI
	tristate "OmniVision OV4689 MIPI sensor support"
	depends on I2C && VIDEO_V4L2
	depends on MEDIA_CAMERA_SUPPORT
	---help---
	  This is a Video4Linux2 sensor-level driver for the OmniVision
	  OV4689 MIPI camera.

	  To compile this driver as a module, choose M here: the
	  module will be called ov4689_mipi.

config LOMBO_OV10640_MIPI
	tristate "OmniVision OV10640 MIPI sensor support"
	depends on I2C && VIDEO_V4L2
	depends on MEDIA_CAMERA_SUPPORT
	---help---
	  This is a Video4Linux2 sensor-level driver for the OmniVision
	  OV10640 MIPI camera.

	  To compile this driver as a module, choose M here: the
	  module will be called ov10640_mipi.

config LOMBO_PR2000K
	tristate "PixelPlus PR2000K AHD chip"
	depends on I2C && VIDEO_V4L2
	depends on MEDIA_CAMERA_SUPPORT
	---help---
	  Support for the PixelPlus PR2000K AHD chip.

	  To compile this driver as a module, choose M here: the
	  module will be called pr2000k.

config LOMBO_TP3810
	tristate "PixelPlus TP3810 chip"
	depends on I2C && VIDEO_V4L2
	depends on MEDIA_CAMERA_SUPPORT
	---help---
	  Support for the PixelPlus TP3810 chip.

	  To compile this driver as a module, choose M here: the
	  module will be called tp3810.

config LOMBO_OV2685_MIPI
	tristate "OmniVision OV2685 MIPI sensor support"
	depends on I2C && VIDEO_V4L2
	depends on MEDIA_CAMERA_SUPPORT
	---help---
	  This is a Video4Linux2 sensor-level driver for the OmniVision
	  OV2685 MIPI camera.

	  To compile this driver as a module, choose M here: the
	  module will be called ov2685_mipi.

config LOMBO_SP2305_DVP
	tristate "SuperPix SP2305 DVP sensor support"
	depends on I2C && VIDEO_V4L2
	depends on MEDIA_CAMERA_SUPPORT
	---help---
	  This is a Video4Linux2 sensor-level driver for the SuperPix
	  SP2305 DVP camera.

	  To compile this driver as a module, choose M here: the
	  module will be called sp2305_dvp.

config LOMBO_OV2735_XC7021_DVP
	tristate "OmniVision OV2735_XC7021 DVP sensor support"
	depends on I2C && VIDEO_V4L2
	depends on MEDIA_CAMERA_SUPPORT
	---help---
	  This is a Video4Linux2 sensor-level driver for the OmniVision
	  OV2735_XC7021 DVP camera.

	  To compile this driver as a module, choose M here: the
	  module will be called ov2735_xc7021_dvp.

config LOMBO_TW2866_DVP
	tristate "TW2866 DVP sensor support"
	depends on I2C && VIDEO_V4L2
	depends on MEDIA_CAMERA_SUPPORT
	---help---
	  This is a Video4Linux2 sensor-level driver for the
	  tw2866 DVP camera.

	  To compile this driver as a module, choose M here: the
	  module will be called tw2866_dvp.

config LOMBO_GC0328_DVP
	tristate "GC0328 DVP sensor support"
	depends on I2C && VIDEO_V4L2
	depends on MEDIA_CAMERA_SUPPORT
	---help---
	  This is a Video4Linux2 sensor-level driver for the GC0328
	  DVP camera.

	  To compile this driver as a module, choose M here: the
	  module will be called gc0328_dvp.

config LOMBO_GC1054_MIPI
	tristate "GC1054 MIPI sensor support"
	depends on I2C && VIDEO_V4L2
	depends on MEDIA_CAMERA_SUPPORT
	---help---
	  This is a Video4Linux2 sensor-level driver for the GC1054
	  MIPI camera.

	  To compile this driver as a module, choose M here: the
	  module will be called gc1054_mipi.
```

## remote_licens/linux-3.10/drivers/misc/lombo/Kconfig
```kconfig
#
# lombo driver configuration
#

config MEMCTRL
	bool "Memctrl driver"
	default n
	help
	  This is a driver for memory debug.

config WIRELESS_PM
	bool "wireless pm driver"
	default n
	help
	  This is a driver for power managerment of wireless module.

config COMBO_MODULE
	bool "support wifi+bt combo module"
	depends on WIRELESS_PM
	help
	  This is a option for support power managerment of wifi+bt
	  combo module.

config LOMBO_MISC
	bool "lombo misc driver"
	default y
	depends on ARCH_LOMBO_N7
	help
	  This is a driver for reading lombo chip-ID and
	  setting upgrade flag by app, default set y because
	  other drivers need to use.

config WIEGAND_RX
	bool "wiegand rx"
	default n
	help
	  This is a driver for wiegand rx.

config WIEGAND_TX
	bool "wiegand tx"
	default n
	help
	  This is a driver for wiegand tx.

config RFKILL_BT
	bool "bt rfkill driver"
	default n
	help
	  This is a driver for providing bt power management control interface.

config LOMBO_MOBILE_PM
	bool "mobile network module pm driver"
	default n
	help
	  This is a driver for providing mobile network module power management
	  control interface for applicantion.
```

## remote_licens/linux-3.10/drivers/pinctrl/lombo/Kconfig
```kconfig
config PINCTRL_N7
	bool "lombo n7 soC pinctrl driver"
	select PINMUX
	select PINCONF
	depends on ARCH_LOMBO_N7
	help
	  Say Y here to enable the n7 soc pinctrl driver

config PINCTRL_N7_SIO
	bool "lombo n7 sio pinctrl driver"
	select PINMUX
	select PINCONF
	depends on ARCH_LOMBO_N7V1
	help
	  Say Y here to enable the n7 sio pinctrl driver

config PINCTRL_N9
	bool "lombo n9 soC pinctrl driver"
	select PINMUX
	select PINCONF
	depends on ARCH_LOMBO_N9
	help
	  Say Y here to enable the n9 soc pinctrl driver.
	  The pin bank name of soc can see defined in dts,
	  bank A/B/C are support normal gpio, bank C can support
	  wakeup interrutp func.

config PINCTRL_N9_SIO
	bool "lombo n9 sio pinctrl driver"
	select PINMUX
	select PINCONF
	depends on ARCH_LOMBO_N9
	help
	  Say Y here to enable the n9 sio pinctrl driver
```

## remote_licens/linux-3.10/drivers/staging/android/ion/Kconfig
```kconfig
menuconfig ION
	bool "Ion Memory Manager"
	depends on HAVE_MEMBLOCK
	select GENERIC_ALLOCATOR
	select DMA_SHARED_BUFFER
	---help---
	  Chose this option to enable the ION Memory Manager,
	  used by Android to efficiently allocate buffers
	  from userspace that can be shared between drivers.
	  If you're not using Android its probably safe to
	  say N here.

config ION_TEST
	tristate "Ion Test Device"
	depends on ION
	help
	  Choose this option to create a device that can be used to test the
	  kernel and device side ION functions.

config ION_DUMMY
	bool "Dummy Ion driver"
	depends on ION
	help
	  Provides a dummy ION driver that registers the
	  /dev/ion device and some basic heaps. This can
	  be used for testing the ION infrastructure if
	  one doesn't have access to hardware drivers that
	  use ION.

config ION_LOMBO
	tristate "Ion for Lombo"
	depends on ARCH_LOMBO && ION
	help
	  Choose this option if you wish to use ion on Lombo Tech platform.

config ION_CARVOUT_SIZE
	hex "carvout size of ion carvout heap"
	depends on ION_LOMBO
	depends on ARCH_LOMBO_N7V0
	help
		please provide the size of the ion carvout heap
```

## remote_licens/linux-3.10/drivers/usb/lombo/Kconfig
```kconfig
config USB_LOMBO
	tristate "Lombo USB Controller"
	depends on (USB_EHCI_HCD || USB_GADGET) && HAS_DMA
	help
	  Say Y here if your system has a dual role high speed USB
	  controller based on Lombo Soc.

	  When compiled dynamically, the module will be called ee-hdc.ko.

if USB_LOMBO

config USB_LOMBO_UDC
	bool "Lombo device controller"
	depends on USB_GADGET
	help
	  Say Y here to enable device controller functionality of the
	  Lombo usb device driver, gadget support is depend on the device
	  driver.
	  UDC driver must use with nx phy driver.

config USB_LOMBO_HOST
	bool "Lombo host controller"
	depends on USB_EHCI_HCD
	select USB_EHCI_ROOT_HUB_TT
	help
	  Say Y here to enable host controller functionality of the
	  Lombo usb host driver, host controller is compatible with
	  ehci.
	  Lombo host driver must use with nx phy driver.

config USB_LOMBO_DEBUG
	bool "Lombo driver debug"
	help
	  Say Y here to enable debugging output of the Lombo driver,
	  when debug driver please select it.

endif
```
